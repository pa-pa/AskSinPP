//- -----------------------------------------------------------------------------------------------------------------------
// AskSin++
// 2016-10-31 papa Creative Commons - http://creativecommons.org/licenses/by-nc-sa/3.0/de/
// adoption of Daniel Otte's cool AVR-Crypto-Lib, Copyright (C) 2008, GPLv3 or later
// cleaned and tidied to fit the purpose for AskSin++ by trilu
//- -----------------------------------------------------------------------------------------------------------------------


#include <string.h>
#include "aes.h"


#ifdef ARDUINO_ARCH_ESP32
#include <pgmspace.h>
#else
#include <avr/pgmspace.h>
#endif

const uint8_t aes_sbox[256] PROGMEM = {
 0x63, 0x7c, 0x77, 0x7b, 0xf2, 0x6b, 0x6f, 0xc5, 0x30, 0x01, 0x67, 0x2b, 0xfe, 0xd7, 0xab, 0x76,
 0xca, 0x82, 0xc9, 0x7d, 0xfa, 0x59, 0x47, 0xf0, 0xad, 0xd4, 0xa2, 0xaf, 0x9c, 0xa4, 0x72, 0xc0,
 0xb7, 0xfd, 0x93, 0x26, 0x36, 0x3f, 0xf7, 0xcc, 0x34, 0xa5, 0xe5, 0xf1, 0x71, 0xd8, 0x31, 0x15,
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 0x8c, 0xa1, 0x89, 0x0d, 0xbf, 0xe6, 0x42, 0x68, 0x41, 0x99, 0x2d, 0x0f, 0xb0, 0x54, 0xbb, 0x16
};

const uint8_t aes_invsbox[256] PROGMEM = {
 0x52, 0x09, 0x6a, 0xd5, 0x30, 0x36, 0xa5, 0x38, 0xbf, 0x40, 0xa3, 0x9e, 0x81, 0xf3, 0xd7, 0xfb,
 0x7c, 0xe3, 0x39, 0x82, 0x9b, 0x2f, 0xff, 0x87, 0x34, 0x8e, 0x43, 0x44, 0xc4, 0xde, 0xe9, 0xcb,
 0x54, 0x7b, 0x94, 0x32, 0xa6, 0xc2, 0x23, 0x3d, 0xee, 0x4c, 0x95, 0x0b, 0x42, 0xfa, 0xc3, 0x4e,
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 0x17, 0x2b, 0x04, 0x7e, 0xba, 0x77, 0xd6, 0x26, 0xe1, 0x69, 0x14, 0x63, 0x55, 0x21, 0x0c, 0x7d
};

extern "C" uint8_t gf256mul(uint8_t a, uint8_t b, uint8_t reducer);


//- aes_enc.cpp

void aes_shiftcol(void *data, uint8_t shift){
	uint8_t tmp[4];
	tmp[0] = ((uint8_t*)data)[ 0];
	tmp[1] = ((uint8_t*)data)[ 4];
	tmp[2] = ((uint8_t*)data)[ 8];
	tmp[3] = ((uint8_t*)data)[12];
	((uint8_t*)data)[ 0] = tmp[(shift+0)&3];
	((uint8_t*)data)[ 4] = tmp[(shift+1)&3];
	((uint8_t*)data)[ 8] = tmp[(shift+2)&3];
	((uint8_t*)data)[12] = tmp[(shift+3)&3];
}

void aes_enc_round(aes_cipher_state_t *state, const aes_roundkey_t *k){
	uint8_t tmp[16], t;
	uint8_t i;
	/* subBytes */
	for(i=0; i<16; ++i){
		tmp[i] = pgm_read_byte(aes_sbox+state->s[i]);
	}
	/* shiftRows */
	aes_shiftcol(tmp+1, 1);
	aes_shiftcol(tmp+2, 2);
	aes_shiftcol(tmp+3, 3);
	/* mixColums */
	for(i=0; i<4; ++i){
		t = tmp[4*i+0] ^ tmp[4*i+1] ^ tmp[4*i+2] ^ tmp[4*i+3];
		state->s[4*i+0] =
			gf256mul(2, tmp[4 * i + 0] ^ tmp[4 * i + 1], 0x1b)
			^ tmp[4*i+0]
			^ t;
		state->s[4*i+1] =
			gf256mul(2, tmp[4 * i + 1] ^ tmp[4 * i + 2], 0x1b)
			^ tmp[4*i+1]
			^ t;
		state->s[4 * i + 2] =
			gf256mul(2, tmp[4 * i + 2] ^ tmp[4 * i + 3], 0x1b)
			^ tmp[4*i+2]
			^ t;
		state->s[4*i+3] =
			gf256mul(2, tmp[4 * i + 3] ^ tmp[4 * i + 0], 0x1b)
			^ tmp[4*i+3]
			^ t;
	}

	/* addKey */
	for(i=0; i<16; ++i){
		state->s[i] ^= k->ks[i];
	}
}

void aes_enc_lastround(aes_cipher_state_t *state,const aes_roundkey_t *k){
	uint8_t i;
	/* subBytes */
	for(i=0; i<16; ++i){
		state->s[i] = pgm_read_byte(aes_sbox+state->s[i]);
	}
	/* shiftRows */
	aes_shiftcol(state->s+1, 1);
	aes_shiftcol(state->s+2, 2);
	aes_shiftcol(state->s+3, 3);
	/* keyAdd */
	for(i=0; i<16; ++i){
		state->s[i] ^= k->ks[i];
	}
}

void aes_encrypt_core(aes_cipher_state_t *state, const aes_genctx_t *ks, uint8_t rounds){
	uint8_t i;
	for(i=0; i<16; ++i){
		state->s[i] ^= ks->key[0].ks[i];
	}
	i=1;
	for(;rounds>1;--rounds){
		aes_enc_round(state, &(ks->key[i]));
		++i;
	}
	aes_enc_lastround(state, &(ks->key[i]));
}


//- aes128_enc.cpp

void aes128_enc(void* buffer, aes128_ctx_t* ctx) {
	aes_encrypt_core((aes_cipher_state_t*)buffer, (aes_genctx_t*)ctx, 10);
}


//- aes_dec.cpp

void aes_invshiftrow(void* data, uint8_t shift) {
	uint8_t tmp[4];
	tmp[0] = ((uint8_t*)data)[(4 + 0 - shift) & 3];
	tmp[1] = ((uint8_t*)data)[(4 + 1 - shift) & 3];
	tmp[2] = ((uint8_t*)data)[(4 + 2 - shift) & 3];
	tmp[3] = ((uint8_t*)data)[(4 + 3 - shift) & 3];
	memcpy(data, tmp, 4);
}

void aes_invshiftcol(void* data, uint8_t shift) {
	uint8_t tmp[4];
	tmp[0] = ((uint8_t*)data)[0];
	tmp[1] = ((uint8_t*)data)[4];
	tmp[2] = ((uint8_t*)data)[8];
	tmp[3] = ((uint8_t*)data)[12];
	((uint8_t*)data)[0] = tmp[(4 - shift + 0) & 3];
	((uint8_t*)data)[4] = tmp[(4 - shift + 1) & 3];
	((uint8_t*)data)[8] = tmp[(4 - shift + 2) & 3];
	((uint8_t*)data)[12] = tmp[(4 - shift + 3) & 3];
}

void aes_dec_round(aes_cipher_state_t* state, const aes_roundkey_t* k) {
	uint8_t tmp[16];
	uint8_t i;
	uint8_t t, u, v, w;
	/* keyAdd */
	for (i = 0; i < 16; ++i) {
		tmp[i] = state->s[i] ^ k->ks[i];
	}
	/* mixColums */
	for (i = 0; i < 4; ++i) {
		t = tmp[4 * i + 3] ^ tmp[4 * i + 2];
		u = tmp[4 * i + 1] ^ tmp[4 * i + 0];
		v = t ^ u;
		v = gf256mul(0x09, v, 0x1b);
		w = v ^ gf256mul(0x04, tmp[4 * i + 2] ^ tmp[4 * i + 0], 0x1b);
		v = v ^ gf256mul(0x04, tmp[4 * i + 3] ^ tmp[4 * i + 1], 0x1b);
		state->s[4 * i + 3] = tmp[4 * i + 3] ^ v ^ gf256mul(0x02, tmp[4 * i + 0] ^ tmp[4 * i + 3], 0x1b);
		state->s[4 * i + 2] = tmp[4 * i + 2] ^ w ^ gf256mul(0x02, t, 0x1b);
		state->s[4 * i + 1] = tmp[4 * i + 1] ^ v ^ gf256mul(0x02, tmp[4 * i + 2] ^ tmp[4 * i + 1], 0x1b);
		state->s[4 * i + 0] = tmp[4 * i + 0] ^ w ^ gf256mul(0x02, u, 0x1b);
	}
	/* shiftRows */
	aes_invshiftcol(state->s + 1, 1);
	aes_invshiftcol(state->s + 2, 2);
	aes_invshiftcol(state->s + 3, 3);
	/* subBytes */
	for (i = 0; i < 16; ++i) {
		state->s[i] = pgm_read_byte(aes_invsbox + state->s[i]);
	}
}

void aes_dec_firstround(aes_cipher_state_t* state, const aes_roundkey_t* k) {
	uint8_t i;
	/* keyAdd */
	for (i = 0; i < 16; ++i) {
		state->s[i] ^= k->ks[i];
	}
	/* shiftRows */
	aes_invshiftcol(state->s + 1, 1);
	aes_invshiftcol(state->s + 2, 2);
	aes_invshiftcol(state->s + 3, 3);
	/* subBytes */
	for (i = 0; i < 16; ++i) {
		state->s[i] = pgm_read_byte(aes_invsbox + state->s[i]);
	}
}

void aes_decrypt_core(aes_cipher_state_t* state, const aes_genctx_t* ks, uint8_t rounds) {
	uint8_t i;
	aes_dec_firstround(state, &(ks->key[i = rounds]));
	for (; rounds > 1; --rounds) {
		--i;
		aes_dec_round(state, &(ks->key[i]));
	}
	for (i = 0; i < 16; ++i) {
		state->s[i] ^= ks->key[0].ks[i];
	}
}


//- aes128_dec.cpp

void aes128_dec(void* buffer, aes128_ctx_t* ctx) {
	aes_decrypt_core((aes_cipher_state_t*)buffer, (aes_genctx_t*)ctx, 10);
}



//- aes_keyschedule.cpp

const uint8_t rc_tab[] PROGMEM = { 0x01, 0x02, 0x04, 0x08, 0x10, 0x20, 0x40, 0x80, 0x1b, 0x36 };

void aes_rotword(void* a) {
	uint8_t t;
	t = ((uint8_t*)a)[0];
	((uint8_t*)a)[0] = ((uint8_t*)a)[1];
	((uint8_t*)a)[1] = ((uint8_t*)a)[2];
	((uint8_t*)a)[2] = ((uint8_t*)a)[3];
	((uint8_t*)a)[3] = t;
}

void aes_init(const void* key, uint16_t keysize_b, aes_genctx_t* ctx) {
	uint8_t hi, i, nk, next_nk;
	uint8_t rc = 0;
	union {
		uint32_t v32;
		uint8_t  v8[4];
	} tmp;
	nk = keysize_b >> 5; /* 4, 6, 8 */
	hi = 4 * (nk + 6 + 1);
	memcpy(ctx, key, keysize_b / 8);
	next_nk = nk;
	for (i = nk; i < hi; ++i) {
		tmp.v32 = ((uint32_t*)(ctx->key[0].ks))[i - 1];
		if (i != next_nk) {
			if (nk == 8 && i % 8 == 4) {
				tmp.v8[0] = pgm_read_byte(aes_sbox + tmp.v8[0]);
				tmp.v8[1] = pgm_read_byte(aes_sbox + tmp.v8[1]);
				tmp.v8[2] = pgm_read_byte(aes_sbox + tmp.v8[2]);
				tmp.v8[3] = pgm_read_byte(aes_sbox + tmp.v8[3]);
			}
		}
		else {
			next_nk += nk;
			aes_rotword(&(tmp.v32));
			tmp.v8[0] = pgm_read_byte(aes_sbox + tmp.v8[0]);
			tmp.v8[1] = pgm_read_byte(aes_sbox + tmp.v8[1]);
			tmp.v8[2] = pgm_read_byte(aes_sbox + tmp.v8[2]);
			tmp.v8[3] = pgm_read_byte(aes_sbox + tmp.v8[3]);
			tmp.v8[0] ^= pgm_read_byte(rc_tab + rc);
			rc++;
		}
		((uint32_t*)(ctx->key[0].ks))[i] = ((uint32_t*)(ctx->key[0].ks))[i - nk]
			^ tmp.v32;
	}
}

void aes128_init(const void* key, aes128_ctx_t* ctx) {
	aes_init(key, 128, (aes_genctx_t*)ctx);
}



//- gf256mul

#ifdef ARDUINO_ARCH_AVR

asm volatile(
	"#include <avr/io.h> \n"

	"A = 23	\n" // param a: r24
	"B = 22	\n" // param b: r22
	"P = 24	\n" // param reducer: r20
	".global gf256mul \n"

	"gf256mul : \n"
	"mov A, r24 \n"
	"clr r24 \n"
	" 1 : \n"
	"  lsr A \n"
	"  breq 4f \n"
	"  brcc 2f \n"
	"  eor P, B \n"
	" 2 : \n"
	"  lsl B \n"
	"  brcc 3f \n"
	"  eor B, r20 \n"
	" 3 : \n"
	"  rjmp 1b \n"
	" 4 : \n"
	"  brcc 2f \n"
	"  eor P, B \n"
	" 2 : \n"
	"  ret \n"
	);

#else

extern "C" uint8_t gf256mul(uint8_t a, uint8_t b, uint8_t reducer) {
	uint8_t i;
	uint8_t p = 0, t;
	for (i = 0; i < 8; ++i) {
		if (b & 1)
			p ^= a;
		t = a & 0x80;
		a <<= 1;
		if (t)
			a ^= reducer;
		b >>= 1;
	}
	return p;
}

#endif
